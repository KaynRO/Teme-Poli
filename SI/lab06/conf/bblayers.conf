## SI/lab06/conf/bblayers.conf
```bitbake
# LAYER_CONF_VERSION is increased each time build/conf/bblayers.conf
# changes incompatibly
LCONF_VERSION = "6"

BBPATH = "${TOPDIR}"
BBFILES ?= ""

BBLAYERS ?= " \
  /home/kayn/Documents/SI/lab06/poky/meta \
  /home/kayn/Documents/SI/lab06/poky/meta-raspberry \
  /home/kayn/Documents/SI/lab06/poky/meta-yocto \
  /home/kayn/Documents/SI/lab06/poky/meta-yocto-bsp \
  "
BBLAYERS_NON_REMOVABLE ?= " \
  /home/kayn/Documents/SI/lab06/poky/meta \
  /home/kayn/Documents/SI/lab06/poky/meta-yocto \
  "
```
